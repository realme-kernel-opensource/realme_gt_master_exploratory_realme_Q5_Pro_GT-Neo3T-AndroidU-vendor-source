## vendor/oplus/kernel/touchpanel/oplus_touchscreen_v2/Novatek/NT36523_noflash/Kconfig
```kconfig
config TOUCHPANEL_NOVA_NT36523_NOFLASH
#	default y
	tristate "TP nova nt36523 IC enable or not for OPLUS"
	---help---
	say Y to enable driver for Touchpanel useing nova nt36523

config TOUCHPANEL_NT_PEN_SUPPORT
	default n
	depends on TOUCHPANEL_NOVA_NT36523_NOFLASH
	bool "TP nova nt36523 IC enable pen support"
	---help---
	say Y if nt36523 IC enable pen support
```

## vendor/oplus/kernel/touchpanel/oplus_touchscreen_v2/St/ST80Y/Kconfig
```kconfig
config TOUCHPANEL_ST_ST80Y
	tristate "TP ST80Y IC enable or not for OPLUS"
	---help---
	Say Y to enable driver for Touchpanel using ST ST80Y IC
	Say M to enable driver for Touchpanel using ST ST80Y IC as module
```

## vendor/oplus/kernel/touchpanel/oplus_touchscreen_v2/Synaptics/Kconfig
```kconfig
source "drivers/input/touchscreen/oplus_touchscreen_v2/Synaptics/S3706/Kconfig"
source "drivers/input/touchscreen/oplus_touchscreen_v2/Synaptics/Syna_tcm_oncell/Kconfig"
source "drivers/input/touchscreen/oplus_touchscreen_v2/Synaptics/TD4377_noflash/Kconfig"
source "drivers/input/touchscreen/oplus_touchscreen_v2/Synaptics/Syna_tcm_S3910/Kconfig"
```

## vendor/oplus/kernel/touchpanel/oplus_touchscreen_v2/Synaptics/TD4377_noflash/Kconfig
```kconfig
config TOUCHPANEL_SYNAPTICS_TD4377_NOFLASH
#	default y
	tristate "TP td4377 IC enable or not for  OPLUS"
	---help---
	say Y to enable driver for Touchpanel using synaptics td4160
```
